## config/boards/shields/bendover/Kconfig.defconfig
```kconfig
# Copyright (c) 2020 The ZMK Contributors
# SPDX-License-Identifier: MIT

if SHIELD_BENDOVER_LEFT

config ZMK_KEYBOARD_NAME
    default "Bendover"

config ZMK_SPLIT_BLE_ROLE_CENTRAL
    default y

endif

if SHIELD_BENDOVER_LEFT || SHIELD_BENDOVER_RIGHT

config ZMK_SPLIT
    default y

endif

if SHIELD_BENDOVER_LEFT 

config ZMK_SPLIT
	default y

config ZMK_SPLIT_BLE_ROLE_CENTRAL
	default y

endif
```

## config/boards/shields/bendover/Kconfig.shield
```kconfig
config SHIELD_BENDOVER_LEFT
    def_bool $(shields_list_contains,bendover_left)

config SHIELD_BENDOVER_RIGHT
    def_bool $(shields_list_contains,bendover_right
```

## config/west.yml
```yaml
manifest:
  remotes:
    - name: kneecrust
      url-base: https://github.com/kneecrust
  projects:
    - name: zmk
      remote: kneecrust
      revision: main
      import: config/west.yml
  self:
    path: config
```
